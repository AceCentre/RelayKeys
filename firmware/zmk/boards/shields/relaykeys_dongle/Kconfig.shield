## firmware/zmk/boards/shields/relaykeys_dongle/Kconfig.shield
```kconfig
config SHIELD_RELAYKEYS_DONGLE
    def_bool $(shields_list_contains,relaykeys_dongle)
```

## firmware/zmk/west.yml
```yaml
manifest:
  remotes:
    - name: zmkfirmware
      url-base: https://github.com/zmkfirmware
  projects:
    - name: zmk
      path: zmk-firmware
      remote: zmkfirmware
      revision: main
      import: app/west.yml
  self:
    path: zmk
```
